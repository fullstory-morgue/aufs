## Kconfig.in
```kconfig
/* $Id: Kconfig.in,v 1.7 2007/04/30 05:43:22 sfjro Exp $ */

#include <linux/version.h>
#if LINUX_VERSION_CODE >= KERNEL_VERSION(2,6,18)
#include <linux/utsrelease.h>
#endif

config AUFS
	tristate "Another unionfs"
	help
	Aufs is a stackable unification filesystem such as Unionfs,
	which unifies several directories and provides a merged single
	directory.
	In the early days, aufs was entirely re-designed and
	re-implemented Unionfs Version 1.x series. After many original
	ideas, approaches and improvements, it becomes totally
	different from Unionfs while keeping the basic features.
	See Unionfs for the basic features.

if AUFS
comment "These options are generated automatically for "#UTS_RELEASE

config AUFS_FAKE_DM
	bool "Use simplified (fake) nameidata"
	depends on AUFS
	default y
	help
	Faking nameidata (VFS internal data), you can get better performance
	in some cases.

#define HELP \
	Specifies the maximum number of branches (or member directories) in a \
	single aufs. The larger value consumes more system resources and has \
	an impact to performance.
choice
	prompt "Maximum number of branches"
	depends on AUFS
	default AUFS_BRANCH_MAX_127
	help
	HELP
config AUFS_BRANCH_MAX_127
	bool "127"
	help
	HELP
config AUFS_BRANCH_MAX_511
	bool "511"
	help
	HELP
config AUFS_BRANCH_MAX_1023
	bool "1023"
	help
	HELP
/* 128kb is available for kmalloc? */
config AUFS_BRANCH_MAX_32767
	bool "32767"
	help
	HELP
endchoice

#if LINUX_VERSION_CODE >= KERNEL_VERSION(2,6,18)
config AUFS_SYSAUFS
	bool "Use <sysfs>/fs/aufs"
	depends on AUFS
	depends on SYSFS
	default y
	help
	Aufs creates some files under sysfs for various purposes.
	If the number of your branches is large or their path is long
	and you meet the limitation of mount(8), /etc/mtab or
	/proc/mount, you need to enable this option and set aufs
	module parameter brs=1.
	See detail in aufs.5.
comment "SYSAUFS and AUFS_SYSAUFS are disabled"
	depends on SYSFS = n
#endif

#if LINUX_VERSION_CODE >= KERNEL_VERSION(2,6,18)
config AUFS_HINOTIFY
	bool "Use inotify to detect actions on a branch"
	depends on AUFS
	depends on INOTIFY
	default n
	help
	If you want to modify files on branches directly, eg. bypassing aufs,
	and want aufs to detect the changes of them fully, then enable this
	option and use 'udba=inotify' mount option.
	It will damage the performance.
	See detail in aufs.5.

comment "INOTIFY and AUFS_HINOTIFY are disabled"
	depends on INOTIFY = n
#endif

#if LINUX_VERSION_CODE >= KERNEL_VERSION(2,6,18)
config AUFS_EXPORT
	bool "NFS-exportable aufs"
	depends on AUFS
	depends on (AUFS = y && EXPORTFS = y) || (AUFS = m && EXPORTFS)
	default n
	help
	If you want to export your mounted aufs, then enable this
	option. There are serveral requirements to export aufs.
	See detail in aufs.5.

comment "EXPORTFS and AUFS_EXPORT are disabled"
	depends on AUFS
	depends on EXPORTFS = n

comment "AUFS_EXPORT is disabled since EXPORTFS is a module but AUFS"
	depends on AUFS
	depends on EXPORTFS = m && AUFS = y
#endif

#if 0
config AUFS_DLGT
	bool "Delegate the access to the branches from aufs to the kernel thread"
	depends on AUFS
	default n
	help
	If you want aufs to delegate the internal access to the
	branches to the kernel thread, in order to hide the access
	issued by your application from your LSM or something or make your
	application to be traced strictly by the task I/O accounting,
	then enable this option and use 'dlgt' mount option.
	It will damage the performance.
	See detail in aufs.5.
#endif

#if LINUX_VERSION_CODE >= KERNEL_VERSION(2,6,16)
config AUFS_KSIZE_PATCH
	bool "ksize.patch was applied or not"
	depends on AUFS
	depends on AUFS = m
	default n
	help
	Aufs sometimes needs to re-allocate memory. If 'ksize' kernel internal
	function is exported to modules, aufs runs efficiently in some cases.
	If you applied 'CVS_TREE/aufs/ksize.patch' to your kernel and you are
	compiling aufs as a module, then enable this option.
	The ksize.patch does nothing but export the function.
#endif

#if LINUX_VERSION_CODE >= KERNEL_VERSION(2,6,19)
config AUFS_LHASH_PATCH
	bool "lhash.patch for NFS branch was applied or not"
	depends on AUFS
	depends on NFS_FS
	default n
	help
	If you use mounted NFS as an aufs branch filesystem, then you need to
	apply the patch 'CVS_TREE/aufs/lhash.patch' to your kernel source, and
	enable this configuration.
	The lhash.patch makes the kernel function __lookup_hash() global and
	exports it to modules.

comment "NFS_FS and AUFS_LHASH_PATCH are disabled"
	depends on AUFS
	depends on NFS_FS = n
#endif

config AUFS_DEBUG
	bool "Debug aufs"
	depends on AUFS
	default y
	help
	Enable this to compile aufs internal debug code.
	The performance will be damaged.

config AUFS_COMPAT
	bool "Compatibility with Unionfs (obsolete)"
	depends on AUFS
	default n
	help
	This makes aufs compatible with unionfs-style mount options and some
	behaviours.
	The dirs= mount option and =nfsro branch permission flag are always
	interpreted as br: mount option and =ro flag respectively. The
	'debug', 'delete' and 'imap' mount options are ignored.
	If you disable this option, you will get,
	- aufs issues a warning about the ignored mount options
	- the default branch permission flag is set. RW for the first branch,
	  and RO for the rests.
	- the name of a internal file which represents the directory is
	  'opaque', becomes '.wh..wh..opq'
	- the 'diropq=w' mount option is set by default
endif

/*
 * Local variables: ;
 * mode: text;
 * End: ;
 */
```
